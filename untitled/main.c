#include <stdio.h>
#include <stdint.h>
#include <math.h>
#include <sys/time.h>

#define GOTO_XY(X, Y) printf("\033[%d;%dH", (Y), (X))
#define ESC_CODE(C) printf("\033%s", C)

#define GRAPH_WIDTH 64
#define GRAPH_HEIGHT 16
#define START_POS_Y 20
#define START_POS_X 5
#define FFT_SIZE 1024

uint16_t data[] = {0x8, 0x8, 0x8, 0x8, 0x8, 0x8, 0x8, 0x8, 0x8, 0x8, 0x8, 0x9, 0x9, 0x9, 0x9, 0x9, 0x9, 0x9, 0x9, 0x9,
                   0x9, 0x9, 0x9, 0x9, 0x9, 0x9, 0x9, 0x9, 0x9, 0x9, 0x9, 0xa, 0xa, 0xa, 0xa, 0xa, 0xa, 0xa, 0xa, 0xa,
                   0xa, 0xa, 0xa, 0xa, 0xa, 0xa, 0xa, 0xa, 0xa, 0xa, 0xa, 0xa, 0xb, 0xb, 0xb, 0xb, 0xb, 0xb, 0xb, 0xb,
                   0xb, 0xb, 0xb, 0xb, 0xb, 0xb, 0xb, 0xb, 0xb, 0xb, 0xb, 0xb, 0xb, 0xb, 0xc, 0xc, 0xc, 0xc, 0xc, 0xc,
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                   0x8, 0x8, 0x8, 0x8, 0x8, 0x8, 0x8, 0x8};

void waitTimeMilliseconds(uint32_t waitMilliseconds) {
    struct timeval tv;
    gettimeofday(&tv, NULL);
    uint32_t t0 = (((uint32_t) tv.tv_sec) * 1000) + (tv.tv_usec / 1000);
    uint32_t t1;

    do {

        gettimeofday(&tv, NULL);

        t1 = (((uint32_t) tv.tv_sec) * 1000) + (tv.tv_usec / 1000);

    } while (t1 - t0 < waitMilliseconds);

}

void displayGraph(void) {

    uint8_t xPos = START_POS_X, yPos = START_POS_Y, numRuns = 10;
    uint32_t delay = 30, refreshRate = 500;

    uint16_t tickSpacing = 4;
    uint32_t i, j, k = 0, freqPerCol = ceil((double) FFT_SIZE / GRAPH_WIDTH);

    ESC_CODE("[?25l");

    printf("ADC Testing:\n");

    GOTO_XY(xPos, yPos + 1);

    for (i = 0; i < GRAPH_WIDTH; i++) {

        for (j = 0; j < tickSpacing; j++) {
            printf("–");
        }

        printf("|");
        i += tickSpacing;
    }

    for (j = START_POS_Y + 1; j > START_POS_Y - GRAPH_HEIGHT; j--) {

        GOTO_XY(xPos - 1, j);

        printf("|");

        GOTO_XY(xPos + GRAPH_WIDTH, j);

        printf("|");
    }

    fflush(stdout);

    GOTO_XY(xPos, yPos);

    while (numRuns--) {

        for (i = 0; i < GRAPH_WIDTH; i++) {

            /* Clear the column after the one we're about to plot */
            for (j = START_POS_Y; j > START_POS_Y - GRAPH_HEIGHT; j--) {

                GOTO_XY(xPos + 1, j);

                printf(" ");
            }

            GOTO_XY(xPos, yPos);

            /* Plot the column of data */
            for (j = 0; j < (data[k] + 1); j++) {

                printf("#");

                GOTO_XY(xPos, yPos--);
            }

            k += freqPerCol;
            xPos++;
            yPos = START_POS_Y;

            fflush(stdout);

            waitTimeMilliseconds(delay);

        }

        xPos = START_POS_X;
        k = 0;

        waitTimeMilliseconds(refreshRate);

    }

    GOTO_XY(1, START_POS_Y + 5);

}

int main() {
    displayGraph();
    return 0;
}
